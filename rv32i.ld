/* Linker script for programs this emulator can run.
 *
 * The emulator copies an ELF file into memory at its *file offsets* and
 * translates the entry point through the segment that contains it. Code
 * generated by GCC reaches local symbols through pc-relative addressing, so it
 * survives being mapped at the wrong address, but anything it reaches with an
 * absolute address -- a global, a string literal, a .bss array -- does not, and
 * the access lands outside memory.
 *
 * Starting at 0x1000 makes the addresses and the file offsets the same number,
 * so both kinds of access land in the right place. 0x1000 rather than 0
 * because the linker pads the first segment's file offset up to a page
 * boundary, and padding a segment that starts at 0 would put it at 0x1000
 * anyway.
 *
 *   riscv-none-elf-gcc -march=rv32i -mabi=ilp32 -nostdlib -nostartfiles \
 *       -ffreestanding -T rv32i.ld -o program program.c -lgcc
 */
ENTRY(_start)

SECTIONS
{
  . = 0x1000;

  .text : { *(.text.start) *(.text .text.*) }
  .rodata : { *(.rodata .rodata.*) *(.srodata .srodata.*) }
  .data : { *(.data .data.*) *(.sdata .sdata.*) }

  /* .bss has no file content, so it is never loaded; the emulator starts with
   * memory zeroed, which is exactly what .bss needs. */
  .bss : { *(.bss .bss.*) *(.sbss .sbss.*) *(COMMON) }

  /DISCARD/ : { *(.comment) *(.riscv.attributes) *(.eh_frame*) *(.note*) }
}
